## firmware/esp32-c3/main/Kconfig.projbuild
```kconfig
menu "Sage BLE presence node"

choice SAGE_BLE_ROLE
    prompt "BLE node role"
    default SAGE_BLE_RECEIVER

config SAGE_BLE_BEACON
    bool "Carried beacon"

config SAGE_BLE_RECEIVER
    bool "Stationary room receiver"

endchoice

config SAGE_BLE_SERVICE_UUID
    int "BLE beacon service UUID"
    range 61440 65535
    default 65520
    help
        Keep this value identical on the carried beacon, speaker, and room receivers.

config SAGE_BLE_NODE_ID
    string "Receiver node ID"
    default "engineering-c3"
    depends on SAGE_BLE_RECEIVER

config SAGE_PRESENCE_WIFI_SSID
    string "Wi-Fi SSID"
    default ""
    depends on SAGE_BLE_RECEIVER

config SAGE_PRESENCE_WIFI_PASSWORD
    string "Wi-Fi password"
    default ""
    depends on SAGE_BLE_RECEIVER

config SAGE_PRESENCE_SERVER_IP
    string "Sage PC IPv4 address"
    default "192.168.1.20"
    depends on SAGE_BLE_RECEIVER

config SAGE_PRESENCE_SERVER_PORT
    int "Sage voice gateway port"
    range 1 65535
    default 8002
    depends on SAGE_BLE_RECEIVER

config SAGE_PRESENCE_SECRET
    string "Sage voice HMAC secret"
    default ""
    depends on SAGE_BLE_RECEIVER

endmenu
```

## firmware/esp32-c3/sdkconfig.defaults
```kconfig
CONFIG_IDF_TARGET="esp32c3"
CONFIG_BT_ENABLED=y
CONFIG_BT_BLUEDROID_ENABLED=y
CONFIG_BT_BLE_ENABLED=y
CONFIG_BT_BLE_42_FEATURES_SUPPORTED=y
CONFIG_BT_BLE_50_FEATURES_SUPPORTED=n
CONFIG_PARTITION_TABLE_SINGLE_APP_LARGE=y
CONFIG_COMPILER_OPTIMIZATION_SIZE=y
```

## firmware/esp32-wearable/main/Kconfig.projbuild
```kconfig
menu "Sage wearable"

config SAGE_WEARABLE_BUTTON_GPIO
    int "Push-to-talk button GPIO"
    range 0 39
    default 0
    help
        GPIO0 is the usual BOOT button on ESP32-WROOM development boards.

config SAGE_WEARABLE_OLED_SDA
    int "OLED I2C SDA GPIO"
    range 0 39
    default 21

config SAGE_WEARABLE_OLED_SCL
    int "OLED I2C SCL GPIO"
    range 0 39
    default 22

config SAGE_WEARABLE_OLED_ADDRESS
    hex "OLED I2C address"
    range 0x03 0x77
    default 0x3c

config SAGE_WEARABLE_AP_PASSWORD
    string "Setup access-point password"
    default "sage-setup"
    help
        Use at least eight characters. Change this before deploying the wearable.

endmenu
```

## firmware/esp32-wearable/sdkconfig.defaults
```kconfig
CONFIG_IDF_TARGET="esp32"
CONFIG_ESPTOOLPY_FLASHSIZE_4MB=y
CONFIG_ESPTOOLPY_FLASHSIZE="4MB"
CONFIG_PARTITION_TABLE_SINGLE_APP_LARGE=y
CONFIG_BT_ENABLED=y
CONFIG_BT_BLE_ENABLED=n
CONFIG_BTDM_CTRL_MODE_BR_EDR_ONLY=y
CONFIG_BTDM_CTRL_BR_EDR_MAX_SYNC_CONN=1
CONFIG_BT_BLUEDROID_ENABLED=y
CONFIG_BT_CLASSIC_ENABLED=y
CONFIG_BT_A2DP_ENABLE=y
CONFIG_BT_HFP_ENABLE=y
CONFIG_BT_HFP_AG_ENABLE=y
CONFIG_BT_HFP_AUDIO_DATA_PATH_HCI=y
CONFIG_BT_HFP_WBS_ENABLE=y
CONFIG_BT_AVRCP_ENABLED=y
```

## firmware/esp32/main/Kconfig.projbuild
```kconfig
menu "Sage speaker"

config SAGE_VOICE_HOST
    string "Sage PC IPv4 address"
    default "192.168.1.10"
    help
        Local IPv4 address of the Sage PC, without scheme or port.

config SAGE_VOICE_PORT
    int "Sage voice gateway port"
    range 1 65535
    default 8002

config SAGE_VOICE_SECRET
    string "Sage voice HMAC secret"
    default ""
    help
        Use the same random secret as SAGE_VOICE_SECRET on the Sage PC.

config SAGE_BLE_PRESENCE
    bool "Enable bedroom BLE presence greetings"
    default n
    depends on BT_ENABLED && BT_BLUEDROID_ENABLED && BT_CONTROLLER_ENABLED && BT_BLE_ENABLED
    help
        Scan for the configured Sage BLE beacon and report bedroom sightings to Sage.

config SAGE_BLE_NODE_ID
    string "BLE receiver node ID"
    default "bedroom-speaker"
    depends on SAGE_BLE_PRESENCE

config SAGE_BLE_SERVICE_UUID
    int "BLE beacon service UUID"
    range 61440 65535
    default 65520
    help
        Use the same private 16-bit UUID on the carried beacon and all receivers.

config SAGE_CONFIG_PASSWORD
    string "Speaker setup page password"
    default ""
    help
        Password required to change the Sage server address from the local setup page.

config SAGE_WIFI_SSID
    string "Wi-Fi SSID"
    default ""

config SAGE_WIFI_PASSWORD
    string "Wi-Fi password"
    default ""

endmenu
```

## firmware/esp32/sdkconfig.defaults
```kconfig
CONFIG_IDF_TARGET="esp32s3"
CONFIG_ESPTOOLPY_FLASHSIZE_16MB=y
CONFIG_SPIRAM=y
CONFIG_SPIRAM_MODE_OCT=y
CONFIG_SPIRAM_SPEED_80M=y
CONFIG_SPIRAM_USE_MALLOC=y
CONFIG_ESP_DEFAULT_CPU_FREQ_MHZ_240=y
CONFIG_FREERTOS_HZ=1000
CONFIG_BT_ENABLED=y
CONFIG_BT_BLUEDROID_ENABLED=y
CONFIG_BT_BLE_ENABLED=y
CONFIG_PARTITION_TABLE_CUSTOM=y
CONFIG_PARTITION_TABLE_CUSTOM_FILENAME="partitions.csv"
```
